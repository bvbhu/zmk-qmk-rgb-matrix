## Kconfig
```kconfig
# RGB Matrix — Zephyr Kconfig
# 所有 RGB Matrix 参数通过 Kconfig 定义，由 snippet 自动生成
# rgb_matrix_generated_config.h 注入编译。

menuconfig ZMK_RGB_MATRIX
    bool "Enable QMK-style RGB Matrix (ZMK module)"
    default y
    help
      Enable QMK-style RGB Matrix effect engine as a ZMK module.

if ZMK_RGB_MATRIX

config RGB_MATRIX_PERSISTENCE
    bool "Persist RGB Matrix settings to flash"
    default y
    help
      Persist RGB Matrix settings (enable/mode/HSV/speed) via the Zephyr
      settings subsystem. Enabled by default along with the settings stack
      (SETTINGS/NVS/FLASH). Set to n, or explicitly disable CONFIG_SETTINGS,
      to build without persistence and save flash/RAM.

# 持久化依赖栈默认启用。使用 default 而非 select：
# 用户显式设 CONFIG_SETTINGS=n 时仍可关闭，此时持久化代码自动裁剪。
config SETTINGS
    default y if RGB_MATRIX_PERSISTENCE
config SETTINGS_NVS
    default y if RGB_MATRIX_PERSISTENCE && SETTINGS
config NVS
    default y if RGB_MATRIX_PERSISTENCE && SETTINGS
config FLASH
    default y if RGB_MATRIX_PERSISTENCE && SETTINGS
config FLASH_PAGE_LAYOUT
    default y if RGB_MATRIX_PERSISTENCE && SETTINGS
config FLASH_MAP
    default y if RGB_MATRIX_PERSISTENCE && SETTINGS

# HID 指示灯（Caps/Num/Scroll Lock 状态查询）默认启用；
# 未启用时 host_keyboard_led_state() 不编译，指示灯回调不可用。
config ZMK_HID_INDICATORS
    default y if ZMK_RGB_MATRIX

# 模块接管 &rgb_ug 键码，默认关闭 ZMK 内置 underglow 避免双重处理。
config ZMK_RGB_UNDERGLOW
    default n if ZMK_RGB_MATRIX

menu "RGB Matrix Configuration"

config RGB_MATRIX_ROWS
    int "Matrix rows"
    help
      Number of rows in the keyboard matrix.
      REQUIRED: must be set in keyboard .conf, e.g. CONFIG_RGB_MATRIX_ROWS=5.

config RGB_MATRIX_COLS
    int "Matrix columns"
    help
      Number of columns in the keyboard matrix.
      REQUIRED: must be set in keyboard .conf, e.g. CONFIG_RGB_MATRIX_COLS=15.

config RGB_MATRIX_LED_COUNT
    int "LED count"
    help
      Total number of RGB LED pixels on the keyboard.
      REQUIRED: must be set in keyboard .conf, e.g. CONFIG_RGB_MATRIX_LED_COUNT=69.

config RGB_MATRIX_CENTER_X
    int "LED center X coordinate (0-255)"
    default 108
    help
      X center point of the LED coordinate system for symmetric effects.

config RGB_MATRIX_CENTER_Y
    int "LED center Y coordinate (0-255)"
    default 32
    help
      Y center point of the LED coordinate system for symmetric effects.

config RGB_MATRIX_LED_FLUSH_LIMIT
    int "LED flush interval (ms)"
    default 16
    range 1 100
    help
      Interval in milliseconds between LED buffer flushes.

config RGB_WORKQ_STACK_SIZE
    int "RGB workqueue stack size (bytes)"
    default 2048
    range 0 4096
    help
      If > 0, use a dedicated workqueue for RGB rendering.
      If 0, use the system workqueue (saves RAM).

config RGB_MATRIX_HUE_STEP
    int "Hue step"
    default 8
    range 1 255

config RGB_MATRIX_SAT_STEP
    int "Saturation step"
    default 16
    range 1 255

config RGB_MATRIX_VAL_STEP
    int "Value (brightness) step"
    default 16
    range 1 255

config RGB_MATRIX_SPD_STEP
    int "Speed step"
    default 16
    range 1 255

config RGB_MATRIX_MAXIMUM_BRIGHTNESS
    int "Maximum brightness"
    default 225
    range 1 255

config RGB_MATRIX_SETTINGS_SAVE_DEBOUNCE
    int "Settings save debounce delay (ms)"
    default ZMK_SETTINGS_SAVE_DEBOUNCE
    help
      Debounce for saving RGB settings to Flash.
      Default follows the ZMK global CONFIG_ZMK_SETTINGS_SAVE_DEBOUNCE,
      so RGB settings save the same way as other ZMK settings.
      Positive: trailing-edge debounce; 0: write immediately; negative: disable.

config RGB_MATRIX_DEFAULT_HUE
    int "Default hue (0-255)"
    default 170
    range 0 255
    help
      Default hue when no valid settings are loaded.

config RGB_MATRIX_DEFAULT_SAT
    int "Default saturation (0-255)"
    default 255
    range 0 255
    help
      Default saturation when no valid settings are loaded.

config RGB_MATRIX_DEFAULT_VAL
    int "Default value/brightness (0-255)"
    default 200
    range 0 255
    help
      Default value (brightness) when no valid settings are loaded.

config RGB_MATRIX_DEFAULT_SPD
    int "Default animation speed (0-255)"
    default 127
    range 0 255

config RGB_MATRIX_DEFAULT_ON
    bool "Default RGB on at startup"
    default y

config RGB_MATRIX_DEFAULT_MODE
    string "Default effect mode"
    default "CYCLE_LEFT_RIGHT"
    help
      Effect name without RGB_MATRIX_ prefix, e.g. CYCLE_LEFT_RIGHT.

config RGB_MATRIX_KEEP_ON_WIRED
    bool "Keep RGB on when wired (USB powered)"
    default n
    help
      If enabled, RGB stays on in wired mode regardless of idle timeout.
      Wireless mode still obeys CONFIG_ZMK_IDLE_TIMEOUT.

config RGB_LED_CONFIG_CONST
    bool "Declare g_led_config as const"
    default n
    help
      If enabled, g_led_config is declared const in rgb_matrix.h.
      The keyboard's keymap.c must also define g_led_config as const.
      Useful on RAM-constrained MCUs (e.g. STM32F072) to place the
      LED layout in flash rather than RAM.

config RGB_MATRIX_IS_LEFT
    bool "Force is_keyboard_left() to return true"
    default n
    help
      When enabled, is_keyboard_left() always returns true.
      When disabled (default), the RGB MATRIX_IS_LEFT macro stays
      undefined and is_keyboard_left() follows ZMK split role
      (central = left half).

endmenu

menu "RGB Matrix Effects"

comment "Normal effects"

config RGB_MATRIX_EFFECT_ALPHAS_MODS
    bool "Alphas Mods"
    default n
config RGB_MATRIX_EFFECT_GRADIENT_UP_DOWN
    bool "Gradient Up Down"
    default n
config RGB_MATRIX_EFFECT_GRADIENT_LEFT_RIGHT
    bool "Gradient Left Right"
    default n
config RGB_MATRIX_EFFECT_BREATHING
    bool "Breathing"
    default n
config RGB_MATRIX_EFFECT_BAND_SAT
    bool "Band Sat"
    default n
config RGB_MATRIX_EFFECT_BAND_VAL
    bool "Band Val"
    default n
config RGB_MATRIX_EFFECT_BAND_PINWHEEL_SAT
    bool "Band Pinwheel Sat"
    default n
config RGB_MATRIX_EFFECT_BAND_PINWHEEL_VAL
    bool "Band Pinwheel Val"
    default n
config RGB_MATRIX_EFFECT_BAND_SPIRAL_SAT
    bool "Band Spiral Sat"
    default n
config RGB_MATRIX_EFFECT_BAND_SPIRAL_VAL
    bool "Band Spiral Val"
    default n
config RGB_MATRIX_EFFECT_CYCLE_ALL
    bool "Cycle All"
    default n
config RGB_MATRIX_EFFECT_CYCLE_LEFT_RIGHT
    bool "Cycle Left Right"
    default n
config RGB_MATRIX_EFFECT_CYCLE_UP_DOWN
    bool "Cycle Up Down"
    default n
config RGB_MATRIX_EFFECT_RAINBOW_MOVING_CHEVRON
    bool "Rainbow Moving Chevron"
    default n
config RGB_MATRIX_EFFECT_CYCLE_OUT_IN
    bool "Cycle Out In"
    default n
config RGB_MATRIX_EFFECT_CYCLE_OUT_IN_DUAL
    bool "Cycle Out In Dual"
    default n
config RGB_MATRIX_EFFECT_CYCLE_PINWHEEL
    bool "Cycle Pinwheel"
    default n
config RGB_MATRIX_EFFECT_CYCLE_SPIRAL
    bool "Cycle Spiral"
    default n
config RGB_MATRIX_EFFECT_DUAL_BEACON
    bool "Dual Beacon"
    default n
config RGB_MATRIX_EFFECT_RAINBOW_BEACON
    bool "Rainbow Beacon"
    default n
config RGB_MATRIX_EFFECT_RAINBOW_PINWHEELS
    bool "Rainbow Pinwheels"
    default n
config RGB_MATRIX_EFFECT_FLOWER_BLOOMING
    bool "Flower Blooming"
    default n
config RGB_MATRIX_EFFECT_RAINDROPS
    bool "Raindrops"
    default n
config RGB_MATRIX_EFFECT_JELLYBEAN_RAINDROPS
    bool "Jellybean Raindrops"
    default n
config RGB_MATRIX_EFFECT_HUE_BREATHING
    bool "Hue Breathing"
    default n
config RGB_MATRIX_EFFECT_HUE_PENDULUM
    bool "Hue Pendulum"
    default n
config RGB_MATRIX_EFFECT_HUE_WAVE
    bool "Hue Wave"
    default n
config RGB_MATRIX_EFFECT_PIXEL_RAIN
    bool "Pixel Rain"
    default n
config RGB_MATRIX_EFFECT_PIXEL_FLOW
    bool "Pixel Flow"
    default n
config RGB_MATRIX_EFFECT_PIXEL_FRACTAL
    bool "Pixel Fractal"
    default n
config RGB_MATRIX_EFFECT_STARLIGHT
    bool "Starlight"
    default n
config RGB_MATRIX_EFFECT_STARLIGHT_DUAL_SAT
    bool "Starlight Dual Sat"
    default n
config RGB_MATRIX_EFFECT_STARLIGHT_DUAL_HUE
    bool "Starlight Dual Hue"
    default n
config RGB_MATRIX_EFFECT_STARLIGHT_SMOOTH
    bool "Starlight Smooth"
    default n
config RGB_MATRIX_EFFECT_RIVERFLOW
    bool "Riverflow"
    default n

comment "Reactive effects (extra ~80 bytes RAM)"

config RGB_MATRIX_EFFECT_SOLID_REACTIVE_SIMPLE
    bool "Solid Reactive Simple"
config RGB_MATRIX_EFFECT_SOLID_REACTIVE
    bool "Solid Reactive"
config RGB_MATRIX_EFFECT_SOLID_REACTIVE_WIDE
    bool "Solid Reactive Wide"
config RGB_MATRIX_EFFECT_SOLID_REACTIVE_MULTIWIDE
    bool "Solid Reactive Multiwide"
config RGB_MATRIX_EFFECT_SOLID_REACTIVE_CROSS
    bool "Solid Reactive Cross"
config RGB_MATRIX_EFFECT_SOLID_REACTIVE_MULTICROSS
    bool "Solid Reactive Multicross"
config RGB_MATRIX_EFFECT_SOLID_REACTIVE_NEXUS
    bool "Solid Reactive Nexus"
config RGB_MATRIX_EFFECT_SOLID_REACTIVE_MULTINEXUS
    bool "Solid Reactive Mult nexus"
config RGB_MATRIX_EFFECT_SPLASH
    bool "Splash"
config RGB_MATRIX_EFFECT_MULTISPLASH
    bool "Multisplash"
config RGB_MATRIX_EFFECT_SOLID_SPLASH
    bool "Solid Splash"
config RGB_MATRIX_EFFECT_SOLID_MULTISPLASH
    bool "Solid Multisplash"

comment "Framebuffer effects (extra ~96 bytes RAM)"

config RGB_MATRIX_EFFECT_TYPING_HEATMAP
    bool "Typing Heatmap"
config RGB_MATRIX_EFFECT_DIGITAL_RAIN
    bool "Digital Rain"

endmenu
endif
```
